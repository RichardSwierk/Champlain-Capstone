//Dynojet Power Commander V simulator
//Written by: Richard T Swierk
//Date: 4/23/2021
//For use with teensy arduino

#include <Arduino.h>
void setup() {
}

// RawHID packets are always 64 bytes
byte buffer[64];
byte packet[64];
int count=0;
byte hexValues[]={0x01,0x02,0x03,0x04,0x05,0x06,0x07,0x08,0x09,0x0a,0x0b,0x0c,0x0d,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0xfe,0xff};
elapsedMillis msUntilNextSend;

void loop() {
  int n;
  if (count==2){
    count=0;
  }
  if (msUntilNextSend > 10) {
    msUntilNextSend = msUntilNextSend - 10;
    for (int x=0;x>64;x++){
      packet[x]=NULL;
    }
    n = RawHID.recv(packet, 0);
    if (n > 0) {
      byte buffer[64]={0xA1,0xB2,0xC3,0xD4,0x05,0x00,0x1d,0x00,0x01,0xAA,0xAA,0xAA,0x02,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0x00,0x00};
      //random rpm
      buffer[9]=hexValues[random(0,225)];
      //random rpm
      buffer[10]=hexValues[random(3,27)];
      //random throttle
      buffer[17]=hexValues[random(0,100)];
      //Random values
      buffer[11]=hexValues[random(0,255)];
      buffer[13]=hexValues[random(0,255)];
      buffer[14]=hexValues[random(0,255)];
      for(int x=33;x<43;x++){
        buffer[x]=hexValues[random(0,255)];
      }
      RawHID.send(buffer, 0);
    }else{
      if(count==0){
        //Can Pass Packet example 1
        //B1 40 9B 31 02 21 38 00 02 0A 11 00 4C 1B 01 03
        //0A 11 00 4C 1C 29 06 03 0A 11 00 4C 1D 00 00 02
        //0A 11 00 4C 72 01 03 0A 11 00 4C 77 00 00 02 0A
        //11 00 4C 7A 00 02 0A 11 00 4C 7B 00 00 00 E0 7F
        //Make Can Pass packet 1
        byte canPass1[64]={0xAA,0xAA,0xAA,0xAA,0x02,0x21,0x38,0x00,0x02,0x0a,0x11,0x00,0x4c,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0xe0,0x7f};
        for(int x=0;x<4;x++){
          canPass1[x]=hexValues[random(0,255)];
        }
        RawHID.send(canPass1,0);
      }else if(count==1){
        //Can Pass Packet exmaple 2
        //F0 51 A6 01 02 21 1C 00 03 0A 11 00 4C 7E 00 00
        //03 0A 11 00 4C 7F 00 00 03 0A 11 00 4C C5 C9 03
        //B0 31 00 40 A4 AD 04 00 A4 AD 04 00 90 18 00 40
        //E0 7A 05 00 00 00 00 00 64 33 00 40 00 00 E0 7F
        //Make Can Pass packet 2
        byte canPass2[64]={0xAA,0xAA,0xAA,0xAA,0x02,0x21,0x1c,0x00,0x03,0x0a,0x11,0x00,0x4c,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0xe0,0x7f};
        for(int x=0;x<4;x++){
          canPass2[x]=hexValues[random(0,255)];
        }
        RawHID.send(canPass2,0);
      }
      count=count+1;
    }
  }
}
